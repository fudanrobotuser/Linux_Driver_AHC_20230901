## AHC_drivers/CAN/Kconfig
```kconfig
config CAN_AHC_PLATFORM
	tristate "Generic Platform Bus based AHC_CAN driver"
	default y
	---help---
	  This driver support for the PNP1070/AHC0512 chips connected
	  to the "platform bus"
```

## AHC_drivers/COM/Kconfig
```kconfig
config COM_AHC_PLATFORM
	tristate "Generic Platform Bus based AHC_COM driver"
	default y
	---help---
	  This driver support for the PNP0501/AHC0501 chips connected
	  to the "platform bus"
```

## AHC_drivers/GPIO/Kconfig
```kconfig
config GPIO_AHC_PLATFORM
	tristate "Generic Platform Bus based AHC_GPIO driver"
	default y
	---help---
	  This driver support for the PNP1901/AHC0b10 chips connected
	  to the "platform bus"
```

## AHC_drivers/I2C/Kconfig
```kconfig
config I2C_AHC_PLATFORM
	tristate "Generic Platform Bus based AHC_I2C driver"
	default y
	---help---
	  This driver support for the PNP1501/AHC0510 chips connected
	  to the "platform bus"
```

## AHC_drivers/Kconfig
```kconfig
menuconfig AHC_DRV
	tristate "AHC drivers"
	default y
	
if AHC_DRV

source "drivers/AHC/COM/Kconfig"
source "drivers/AHC/GPIO/Kconfig"
source "drivers/AHC/I2C/Kconfig"
source "drivers/AHC/SMB/Kconfig"
source "drivers/AHC/CAN/Kconfig"

endif
```

## AHC_drivers/SMB/Kconfig
```kconfig
config SMB_AHC_PLATFORM
	tristate "Generic Platform Bus based AHC_SMB driver"
	default y
	---help---
	  This driver support for the PNP1511/AHC0511 chips connected
	  to the "platform bus"
```
